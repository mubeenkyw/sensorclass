#include <math.h>
int SensorPin = 0;
int Vout;
float R1 = 10000;
float b = 3435;
float t0 = 273.15;
float adc, logR,T, R, temprtCal, logR2, R2, tt, error;
float c1 = 1.009249522e-03, c2 = 2.378405444e-04, c3 = 2.019202697e-07;
int data[150][2] = {
  {1, -87},
  {10, -60},
  {20, -50},
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  {1020, 301}};
//........................................MK..........................................
void setup() {
  Serial.begin(9600);
}
float cal_Temp(float adc)
{
  Vout = analogRead(SensorPin);
  R2 = R1 * (1023.0 / (float)Vout - 1.0);logR2 = log(R2);
  tt = (1.0 / (c1 + c2 * logR2 + c3 * logR2 * logR2 * logR2));
  tt = tt - 273.15;
  R = (1024 / adc - 1);logR = log(R);
  T = 1.0 / (1 / (tt + t0) + 1 / b * logR);
  temprtCal = T - 273.15;
  return T;
}
//.......................................Mk..........................................
float cal_Lin(int adc)
{
  float c = 0;
  if (0 < adc && adc < 40)
  {
    c = (1.4014 * adc) - 81.98;}
    
  else if ( 40 <= adc && adc < 150)
  {
    c = (0.2232 * adc) - 46.55;}
    
  else if (150 <= adc && adc < 800)
  {
    c = (0.1097 * adc) - 30.04;}
    
  else if (800 <= adc && adc < 900)
  {
    c = (0.2468 * adc) - 136.45;}
    
  else if (900 <= adc && adc < 980)
  {
    c = (0.5821 * adc) - 440.41;}
    
  else if (980 <= adc && adc < 1023)
  {
    c = (6.4596 * adc) - 6246.35;}
    
  return c;
}
int get_temp(int adc)
{
  int i = 0;
  while (data[i][0] < adc)i++;
  return (data[i][1]);
}
//................................................MK.........................................
void loop()
{
  if (adc < 1024)
    for (adc = 0; adc < 1024; adc = adc + 10)
    {
      error = (cal_Lin(adc) - temprtCal);
      Serial.print(adc);
      Serial.print( " adc ");
      Serial.println();
      Serial.print(cal_Temp(adc));
      Serial.print(" Kelvin ");
      Serial.println();
      Serial.print(get_temp(adc)); 
      Serial.print( " Excel ");
      Serial.println();
      Serial.print(temprtCal);
      Serial.print(" T-Cel ");
      Serial.println();
      Serial.print(cal_Lin(adc));
      Serial.print(" L-T-Cel ");
      Serial.println();
      Serial.print(error); 
      Serial.print( " Error"); 
      Serial.println();
      delay(3000);
    }
}

